// SPDX-License-Identifier: Apache-2.0
/* "JetHome" boot splash on the OLED, read by ssd1307fb at probe */

/dts-v1/;
/plugin/;

&ssd1306 {
	/* 128x64, 1 bpp, 16 bytes per row, leftmost pixel in bit 0 */
	solomon,splash = [
		00 00 00 00 00 00 00 00 00 00 00 00 00 00 00 00
		00 00 00 00 00 00 00 00 00 00 00 00 00 00 00 00
		00 00 00 00 00 00 00 00 00 00 00 00 00 00 00 00
		00 00 00 00 00 00 00 00 00 00 00 00 00 00 00 00
		00 00 00 00 00 00 00 00 00 00 00 00 00 00 00 00
		00 00 00 00 00 00 00 00 00 00 00 00 00 00 00 00
		00 00 00 00 00 00 00 00 00 00 00 00 00 00 00 00
		00 00 00 00 00 00 00 00 00 00 00 00 00 00 00 00
		00 00 00 00 00 00 00 00 00 00 00 00 00 00 00 00
		00 00 00 00 00 00 00 00 00 00 00 00 00 00 00 00
		00 00 00 00 00 00 00 00 00 00 00 00 00 00 00 00
		00 00 00 00 00 00 00 00 00 00 00 00 00 00 00 00
		00 00 00 00 00 00 00 00 00 00 00 00 00 00 00 00
		00 00 00 00 00 00 00 00 00 00 00 00 00 00 00 00
		00 00 00 00 00 00 00 00 00 00 00 00 00 00 00 00
		00 00 00 00 00 00 00 00 00 00 00 00 00 00 00 00
		00 00 00 00 00 00 00 00 00 00 00 00 00 00 00 00
		00 00 00 00 00 00 00 00 00 00 00 00 00 00 00 00
		00 00 00 00 00 00 00 00 00 00 00 00 00 00 00 00
		00 00 00 00 00 00 00 00 00 00 00 00 00 00 00 00
		00 00 00 00 00 00 00 00 00 00 00 00 00 00 00 00
		00 00 00 00 00 00 00 00 00 00 00 00 00 00 00 00
		00 f0 01 00 00 80 0f f8 00 00 00 00 00 00 00 00
		00 f0 01 00 00 80 0f f8 00 00 00 00 00 00 00 00
		00 f0 01 00 f0 81 0f f8 00 00 00 00 00 00 00 00
		00 f0 01 00 f0 81 0f f8 00 00 00 00 00 00 00 00
		00 f0 01 00 f0 81 0f f8 00 00 00 00 00 00 00 00
		00 f0 01 00 f0 81 0f f8 00 00 00 00 00 00 00 00
		00 f0 01 3f fc 8f 0f f8 00 7e e0 f8 f0 00 fc 00
		00 f0 c1 ff fc 8f 0f f8 80 ff e0 ff fd 03 ff 03
		00 f0 e1 ff fc 8f ff ff c0 ff e1 ff ff 83 ff 03
		00 f0 e1 ff fd 8f ff ff e0 ff e3 ff ff 87 ff 07
		00 f0 f1 f1 f1 81 ff ff f0 e3 e3 e3 e7 c7 c7 07
		00 f0 f1 e1 f1 81 ff ff f0 c1 e7 e3 c3 c7 87 07
		f0 f1 f1 ff f1 81 0f f8 f0 c1 e7 e3 c3 c7 ff 07
		f0 f1 f1 ff f1 81 0f f8 f0 c1 e7 e3 c3 c7 ff 07
		f0 f1 f1 ff f1 81 0f f8 f0 c1 e7 e3 c3 c7 ff 07
		f0 fb f1 01 f0 81 0f f8 f0 e3 e3 e3 c3 c7 07 00
		e0 ff e1 ff f0 8f 0f f8 e0 ff e3 e3 c3 87 ff 03
		e0 ff e0 ff e1 8f 0f f8 e0 ff e1 e3 c3 87 ff 07
		c0 7f c0 ff c1 9f 0f f8 c0 ff e0 e3 c3 07 ff 07
		00 1f 00 ff 80 9f 0f f8 00 3f e0 e3 c3 07 fc 03
		00 00 00 00 00 00 00 00 00 00 00 00 00 00 00 00
		00 00 00 00 00 00 00 00 00 00 00 00 00 00 00 00
		00 00 00 00 00 00 00 00 00 00 00 00 00 00 00 00
		00 00 00 00 00 00 00 00 00 00 00 00 00 00 00 00
		00 00 00 00 00 00 00 00 00 00 00 00 00 00 00 00
		00 00 00 00 00 00 00 00 00 00 00 00 00 00 00 00
		00 00 00 00 00 00 00 00 00 00 00 00 00 00 00 00
		00 00 00 00 00 00 00 00 00 00 00 00 00 00 00 00
		00 00 00 00 00 00 00 00 00 00 00 00 00 00 00 00
		00 00 00 00 00 00 00 00 00 00 00 00 00 00 00 00
		00 00 00 00 00 00 00 00 00 00 00 00 00 00 00 00
		00 00 00 00 00 00 00 00 00 00 00 00 00 00 00 00
		00 00 00 00 00 00 00 00 00 00 00 00 00 00 00 00
		00 00 00 00 00 00 00 00 00 00 00 00 00 00 00 00
		00 00 00 00 00 00 00 00 00 00 00 00 00 00 00 00
		00 00 00 00 00 00 00 00 00 00 00 00 00 00 00 00
		00 00 00 00 00 00 00 00 00 00 00 00 00 00 00 00
		00 00 00 00 00 00 00 00 00 00 00 00 00 00 00 00
		00 00 00 00 00 00 00 00 00 00 00 00 00 00 00 00
		00 00 00 00 00 00 00 00 00 00 00 00 00 00 00 00
		00 00 00 00 00 00 00 00 00 00 00 00 00 00 00 00
		00 00 00 00 00 00 00 00 00 00 00 00 00 00 00 00
	];
};
