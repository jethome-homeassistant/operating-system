## buildroot-external/package/amlogic-boot-fip-j310/Config.in
```kconfig
config BR2_PACKAGE_AMLOGIC_BOOT_FIP_J310
	 bool "amlogic-boot-fip-j310"
	 help
	   This package builds the Amlogic S7 (S905Y5) FIP bootloader
	   image for the JetHome JetHub D3-mini (j310) from the JetHome
	   fork of the amlogic-boot-fip repository.

	   It wraps the U-Boot binary (BL33) together with the signed
	   vendor boot blobs (bb1st, BL2E, BL2X, DDR FIP, device FIP)
	   into the eMMC/SD and USB bootloader images.

	   https://github.com/jethome-iot/amlogic-boot-fip

if BR2_PACKAGE_AMLOGIC_BOOT_FIP_J310

config BR2_PACKAGE_AMLOGIC_BOOT_FIP_J310_BOARD
	string "Board uboot firmware config"
	default "jethub-j310"
	depends on BR2_PACKAGE_AMLOGIC_BOOT_FIP_J310
	help
	  Name of the board for which U-Boot firmware should be built
	  from amlogic-boot-fip
endif
```

## buildroot-external/package/jethome-burn/Config.in
```kconfig
config BR2_PACKAGE_JETHOME_BURN
	 bool "jethome-burn"
	 help
	   This package installs the jethome-tools tree, which the post-image
	   step uses to build Amlogic USB-burn images.

	   The board is selected by BURN_BOARD in the board meta file
	   not here, so that the burn board name has a
	   single source of truth next to BOARD_ID.

	   https://github.com/jethome-iot/jethome-tools
```

## buildroot-external/package/jethub-init/Config.in
```kconfig
config BR2_PACKAGE_JETHUB_INIT
	bool "jethub-init"
	select BR2_PACKAGE_LIBGPIOD2
	select BR2_PACKAGE_LIBGPIOD2_TOOLS
	help
	  JetHub hardware init for HAOS: the board's jethub-init script
	  (GPIO / LED / zigbee / UXM setup), POSIX sh + libgpiod v2,
	  run by jethub-initer.service. Installed from the release
	  tarball, the same scripts the Armbian packages carry.

	  https://github.com/jethome-iot/jethub-init

if BR2_PACKAGE_JETHUB_INIT

config BR2_PACKAGE_JETHUB_INIT_BOARD
	string "JetHub board (j80 / j100 / j200 / j310)"
	help
	  Board folder in the tarball whose jethub-init is installed as
	  /usr/lib/jethome/jethub-init.

endif
```

## buildroot-external/package/jethub-oled/Config.in
```kconfig
config BR2_PACKAGE_JETHUB_OLED
	bool "jethub-oled"
	depends on BR2_PACKAGE_PYTHON3
	select BR2_PACKAGE_PYTHON_PILLOW # runtime
	select BR2_PACKAGE_FREETYPE # runtime, TrueType in Pillow
	select BR2_PACKAGE_DEJAVU # runtime
	select BR2_PACKAGE_DEJAVU_MONO # runtime, clock digits
	select BR2_PACKAGE_DEJAVU_SANS # runtime, screen headers
	select BR2_PACKAGE_DEJAVU_SANS_CONDENSED # runtime, everything else
	help
	  Status screens and a joystick menu on the SSD1306 OLED of
	  JetHub J310: CPU and RAM rings with temperature and uptime,
	  the IP address, a clock, Ethernet and Wi-Fi details (through
	  nmcli) and reboot. Drawn with Pillow through the ssd1307fb
	  framebuffer.

	  A badge on the resources screen shows whether Home Assistant
	  Core is starting, ready or failing, read from Core over the
	  Unix socket it opens for Supervisor.

	  Also installs the boot logo overlay jethub-oled-splash.dtbo,
	  which ssd1307fb shows from probe until the daemon starts.
```
